## boards/shields/bung/Kconfig.shield
```kconfig
config SHIELD_BUNG_LEFT
    def_bool $(shields_list_contains,bung_left)
  
config SHIELD_BUNG_RIGHT
    def_bool $(shields_list_contains,bung_right)
  
```
